## Kconfig
```kconfig
menuconfig PAW3222
    bool "PAW3222 mouse optical sensor"
    select SPI
    depends on INPUT
    depends on DT_HAS_XINTA_PAW3222_ENABLED
    help
      Enable PAW3222 mouse optical sensor.
```

## dts/bindings/xinta,paw3222.yaml
```yaml
# Copyright 2024 Google LLC
# Copyright 2025 sekigon-gonnoc
# SPDX-License-Identifier: Apache-2.0

description: PAW32xx ultra low power wireless mouse chip

compatible: "xinta,paw3222"

include: spi-device.yaml

properties:
  irq-gpios:
    type: phandle-array
    required: true
    description:
      GPIO connected to the motion pin, active low.

  power-gpios:
    type: phandle-array
    required: false
    description:
      GPIO connected to the power control pin.

  cpi:
    type: int
    description: |
      CPI resolution for the sensor. This can also be changed in runtime using
      the paw32xx_set_resolution() API.

  evt-type:
    type: int
    required: true

  x-input-code:
    type: int
    required: true

  y-input-code:
    type: int
    required: true

  force-awake:
    type: boolean
    description: |
      Initialize the sensor in "force awake" mode. This can also be enabled or
      disabled in runtime by the application using the paw32xx_force_awake()
      API.

  disable-burst-read:
    type: boolean
    description: |
      If true, disables burst read and uses single register reads for motion data. Default is false.
```
